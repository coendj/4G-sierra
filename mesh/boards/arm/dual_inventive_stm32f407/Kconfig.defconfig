## mesh/boards/arm/dual_inventive_stm32f407/Kconfig.defconfig
```kconfig
# SEGGER-DI-STM32F407 board configuration

if BOARD_SEGGER_DI_STM32F407

config BOARD
	default "segger_di_stm32f407"

endif # BOARD_SEGGER_DI_STM32F407
```

## mesh/boards/arm/dual_inventive_stm32f407/dual_inventive_stm32f407_defconfig
```kconfig
# SPDX-License-Identifier: Apache-2.0

# General
CONFIG_SOC_SERIES_STM32F4X=y
CONFIG_SOC_STM32F407XG=y

# enable pin controller
CONFIG_PINCTRL=y

# enable GPIO
CONFIG_GPIO=y

# Enable MPU
CONFIG_ARM_MPU=y

# Enable HW stack protection
CONFIG_HW_STACK_PROTECTION=y

# Enable Clocks
CONFIG_CLOCK_CONTROL=y

# Enable the SX12XX radio driver for Lora
CONFIG_SPI=y
CONFIG_LORA=y
CONFIG_LORA_LOG_LEVEL_DBG=y
CONFIG_LORA_SX127X=y

# Enable Serial
CONFIG_PRINTK=y
CONFIG_SERIAL=y
CONFIG_CONSOLE=y

# Serial communicaton
CONFIG_UART_CONSOLE=y
CONFIG_UART_LINE_CTRL=y
CONFIG_UART_INTERRUPT_DRIVEN=y
CONFIG_CONSOLE_SUBSYS=y
CONFIG_CONSOLE_GETCHAR=y
CONFIG_CONSOLE_GETLINE=y

CONFIG_LOG=y
CONFIG_LOG_PRINTK=y

CONFIG_SYSTEM_WORKQUEUE_STACK_SIZE=2048

CONFIG_MQTT_LIB=y
CONFIG_NETWORKING=y

# Disable IPv6 support
CONFIG_NET_IPV6=n

# Enable IPv4 support
CONFIG_NET_IPV4=y
CONFIG_NET_IF_MAX_IPV4_COUNT=2
CONFIG_NET_IF_UNICAST_IPV4_ADDR_COUNT=3

# Enable TCP support
CONFIG_NET_TCP=y

# Enable Sockets support
CONFIG_NET_SOCKETS=y
CONFIG_NET_SOCKETS_SOCKOPT_TLS=y

# UART support
CONFIG_SERIAL=y
```

## mesh/unit_test_prototype/boards/arm/dual_inventive_stm32f407/Kconfig.board
```kconfig
# SEGGER-DI-STM32F407 board configuration

config BOARD_SEGGER_DI_STM32F407
	bool "SEGGER STM32F407 Dual Inventive Board"
	depends on SOC_STM32F407
```

## samples/mesh/unit_test_prototype/boards/arm/dual_inventive_stm32f407/dual_inventive_stm32f407_defconfig
```kconfig
# SPDX-License-Identifier: Apache-2.0

# General
CONFIG_SOC_SERIES_STM32F4X=y
CONFIG_SOC_STM32F407XG=y

# enable pin controller
CONFIG_PINCTRL=y

# enable GPIO
CONFIG_GPIO=y

# Enable MPU
CONFIG_ARM_MPU=y

# Enable HW stack protection
CONFIG_HW_STACK_PROTECTION=y

# Enable Clocks
CONFIG_CLOCK_CONTROL=y

# Enable the SX12XX radio driver for Lora
CONFIG_SPI=y
CONFIG_LORA=y
CONFIG_LORA_LOG_LEVEL_DBG=y
CONFIG_LORA_SX127X=y

# Enable Serial
CONFIG_PRINTK=y
CONFIG_SERIAL=y
CONFIG_CONSOLE=y

# Serial communicaton
CONFIG_UART_CONSOLE=y
CONFIG_UART_LINE_CTRL=y
CONFIG_UART_INTERRUPT_DRIVEN=y
CONFIG_CONSOLE_SUBSYS=y
CONFIG_CONSOLE_GETCHAR=y
CONFIG_CONSOLE_GETLINE=y

CONFIG_LOG=y
CONFIG_LOG_PRINTK=y

CONFIG_SYSTEM_WORKQUEUE_STACK_SIZE=2048
```

## samples/mesh/unit_test_prototype/testcase.yaml
```yaml
tests:
  sample.testing.unit-tests:
    build_only: true
    platform_allow: 
      - native_posix
      - native_sim
    integration_platforms:
      - native_posix
      - native_sim
    tags: 
      - testing
      - uart
      - serial
```
